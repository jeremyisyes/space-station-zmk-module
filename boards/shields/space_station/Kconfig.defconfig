## boards/shields/space_station/Kconfig.defconfig
```kconfig
# Copyright (c) 2024 The ZMK Contributors
# SPDX-License-Identifier: MIT

if SHIELD_SPACE_STATION

config ZMK_KEYBOARD_NAME
    default "Space Station"

config ZMK_SLEEP
    default y
    depends on SOC_SERIES_NRF52X

endif
```

## boards/shields/space_station/Kconfig.shield
```kconfig
# Copyright (c) 2024 The ZMK Contributors
# SPDX-License-Identifier: MIT

config SHIELD_SPACE_STATION
   def_bool $(shields_list_contains,space_station)
```
